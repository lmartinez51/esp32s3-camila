## solutions/openai_camila/main/Kconfig
```kconfig
menu "Robot HAL"

config ROBOT_HAL
    bool "Enable Robot HAL abstraction"
    default y
    help
        Protocol-agnostic device abstraction: normalized command bus,
        driver table and device registry (main/hal, main/drivers, main/registry).
        When disabled, the WebRTC tool adapter falls back entirely to the
        legacy BLE control path.

config ROBOT_PROBE_TIMEOUT_MS
    int "BLE probe scan timeout (ms)"
    range 100 2000
    default 400
    depends on ROBOT_HAL
    help
        Budget for the bounded passive scan used by BLE driver probe().
        Drivers answer "device offline" to the LLM within this window,
        keeping the voice round-trip responsive (< 500 ms rule).

config ROBOT_PROBE_CACHE_MS
    int "Probe presence cache TTL (ms)"
    range 0 60000
    default 10000
    depends on ROBOT_HAL
    help
        After a successful probe/command, robot_hal_execute() skips the
        probe for this window (presence cache). Absent results are never
        cached, so an offline device is re-probed on every command.

config ROBOT_WIFI_EXEC_TIMEOUT_MS
    int "WiFi command I/O timeout (ms)"
    range 100 10000
    default 1500
    depends on ROBOT_HAL
    help
        Budget for connect/send on wifi_tcp and for the HTTP request on
        wifi_http. Keeps the command path bounded so the voice round-trip
        stays responsive.

config ROBOT_HTTP_COMMAND_PATH
    string "HTTP REST command path"
    default "/command"
    depends on ROBOT_HAL
    help
        Path appended to http://<ip>:<port> for the wifi_http driver.
        The driver POSTs JSON: {"action": ..., "speed": ..., "duration_ms": ...}

config ROBOT_IR_TX_GPIO
    int "IR emitter GPIO (RMT TX)"
    range 0 47
    default 39
    depends on ROBOT_HAL
    help
        GPIO driving the IR LED (38 kHz carrier). Wired to a free pin —
        MUST NOT collide with the ESP32-S3-BOX-3 critical pins (I2S
        SCLK=17, I2C SCL=18, I2S/LCD/USB/etc). Default 39 matches the
        legacy IR module wiring (RX=38, PWR=44); adjust per board.

config ROBOT_IR_RX_GPIO
    int "IR receiver GPIO (RMT RX)"
    range 0 47
    default 38
    depends on ROBOT_HAL
    help
        GPIO wired to the TSOP38xxx IR receiver output (active-low).
        Same pin-safety rule as the TX pin: never 17 (I2S SCLK) or
        18 (I2C SCL) on the ESP32-S3-BOX-3. Default 38 matches the
        legacy IR module wiring.

config ROBOT_IR_LEARN_TIMEOUT_MS
    int "IR learn capture window (ms)"
    range 500 10000
    default 2500
    depends on ROBOT_HAL
    help
        Maximum wait for a single IR frame during LEARN_IR_CODE. The
        voice round-trip stays bounded (< 5 s) while the user aims the
        remote and presses a button.

config ROBOT_HAL_HEALTH_INTERVAL_S
    int "HAL health monitor interval (s)"
    range 10 3600
    default 60
    depends on ROBOT_HAL
    help
        Period of the robot_health task: memory budget snapshot
        (Internal + PSRAM), registry/driver counts and registry
        integrity pass. 0 disables periodic logging (task still runs).

config ROBOT_HAL_EXEC_WATCHDOG_MS
    int "HAL execute watchdog (ms)"
    range 500 10000
    default 3000
    depends on ROBOT_HAL
    help
        If a driver execute() exceeds this budget, robot_hal_execute()
        logs an error (stuck-connection reaper). Drivers bound their own
        I/O; this log catches regressions during the soak test.

config ROBOT_HAL_MAX_INFLIGHT
    int "Max in-flight ops per driver"
    range 1 8
    default 2
    depends on ROBOT_HAL
    help
        Per-driver concurrency cap in robot_hal_execute(). All execute()
        calls are synchronous and bounded, so the cap only trips under
        abnormal conditions (reentrancy, stuck connection) and returns
        ESP_ERR_TIMEOUT with a friendly message.

endmenu
```

## solutions/openai_camila/sdkconfig.defaults
```kconfig
# Enable SPIRAM
CONFIG_SPIRAM=y
CONFIG_FREERTOS_TASK_CREATE_ALLOW_EXT_MEM=y
CONFIG_SPIRAM_ALLOW_STACK_EXTERNAL_MEMORY=y

# Enable GDBStub
CONFIG_ESP_SYSTEM_PANIC_GDBSTUB=y

# Enable FreeRTOS trace
CONFIG_FREERTOS_USE_TRACE_FACILITY=y
CONFIG_FREERTOS_VTASKLIST_INCLUDE_COREID=y
CONFIG_FREERTOS_GENERATE_RUN_TIME_STATS=y

# Support 2 SNTP
CONFIG_LWIP_SNTP_MAX_SERVERS=2

# Enable DTLS SRTP
CONFIG_MBEDTLS_SSL_PROTO_DTLS=y
CONFIG_MBEDTLS_SSL_DTLS_SRTP=y

# Use new I2C master
CONFIG_CODEC_I2C_BACKWARD_COMPATIBLE=n

# Enable experimental features
CONFIG_IDF_EXPERIMENTAL_FEATURES=y

# Use custom partition table
CONFIG_PARTITION_TABLE_CUSTOM=y
CONFIG_PARTITION_TABLE_CUSTOM_FILENAME="partitions.csv"

CONFIG_ESP_WIFI_CSI_ENABLED=y

# WebRTC/BLE coexistence memory recovery
CONFIG_BT_ENABLED=y
CONFIG_BT_NIMBLE_ENABLED=y
CONFIG_BT_NIMBLE_MEM_ALLOC_MODE_EXTERNAL=y
CONFIG_BT_NIMBLE_MAX_CONNECTIONS=1
CONFIG_BT_NIMBLE_MAX_BONDS=2
CONFIG_BT_NIMBLE_MAX_CCCDS=4
CONFIG_BT_NIMBLE_ATT_PREFERRED_MTU=185
CONFIG_BT_NIMBLE_ATT_MAX_PREP_ENTRIES=4
CONFIG_BT_NIMBLE_MSYS_1_BLOCK_COUNT=24
CONFIG_BT_NIMBLE_MSYS_1_BLOCK_SIZE=256
CONFIG_BT_NIMBLE_MSYS_2_BLOCK_COUNT=12
CONFIG_BT_NIMBLE_MSYS_2_BLOCK_SIZE=320
CONFIG_BT_NIMBLE_TRANSPORT_ACL_FROM_LL_COUNT=8
CONFIG_BT_NIMBLE_TRANSPORT_ACL_SIZE=255
CONFIG_BT_NIMBLE_TRANSPORT_EVT_COUNT=12
CONFIG_BT_NIMBLE_TRANSPORT_EVT_DISCARD_COUNT=4
CONFIG_BT_NIMBLE_GATT_MAX_PROCS=2
# CONFIG_BT_NIMBLE_ENABLE_CONN_REATTEMPT is not set
# CONFIG_BT_NIMBLE_50_FEATURE_SUPPORT is not set
# CONFIG_BT_NIMBLE_LL_CFG_FEAT_LE_2M_PHY is not set
# CONFIG_BT_NIMBLE_LL_CFG_FEAT_LE_CODED_PHY is not set
# CONFIG_BT_NIMBLE_EXT_SCAN is not set
# CONFIG_BT_NIMBLE_ENABLE_PERIODIC_SYNC is not set
CONFIG_BT_NIMBLE_WHITELIST_SIZE=4
# CONFIG_BT_NIMBLE_PROX_SERVICE is not set
# CONFIG_BT_NIMBLE_ANS_SERVICE is not set
# CONFIG_BT_NIMBLE_CTS_SERVICE is not set
# CONFIG_BT_NIMBLE_HTP_SERVICE is not set
# CONFIG_BT_NIMBLE_IPSS_SERVICE is not set
# CONFIG_BT_NIMBLE_TPS_SERVICE is not set
# CONFIG_BT_NIMBLE_IAS_SERVICE is not set
# CONFIG_BT_NIMBLE_LLS_SERVICE is not set
# CONFIG_BT_NIMBLE_SPS_SERVICE is not set
# CONFIG_BT_NIMBLE_HR_SERVICE is not set
# CONFIG_BT_NIMBLE_BAS_SERVICE is not set
# CONFIG_BT_NIMBLE_DIS_SERVICE is not set
CONFIG_BT_NIMBLE_GAP_SERVICE=y
CONFIG_BT_CTRL_BLE_MAX_ACT=2
CONFIG_BT_CTRL_ADV_DUP_FILT_MAX=10
CONFIG_BT_CTRL_BLE_ADV_REPORT_FLOW_CTRL_NUM=50
CONFIG_BT_CTRL_BLE_ADV_REPORT_DISCARD_THRSHOLD=8
CONFIG_BT_CTRL_SCAN_DUPL_CACHE_SIZE=20
# CONFIG_BT_CTRL_DTM_ENABLE is not set
CONFIG_SPIRAM_USE_MALLOC=y
CONFIG_SPIRAM_MALLOC_ALWAYSINTERNAL=2048
CONFIG_SPIRAM_TRY_ALLOCATE_WIFI_LWIP=y
CONFIG_NVS_ALLOCATE_CACHE_IN_SPIRAM=y
CONFIG_HEAP_TRACING_OFF=y
# CONFIG_HEAP_TRACING is not set
CONFIG_MBEDTLS_EXTERNAL_MEM_ALLOC=y
CONFIG_MBEDTLS_SSL_VARIABLE_BUFFER_LENGTH=y
# CONFIG_MBEDTLS_SSL_KEEP_PEER_CERTIFICATE is not set
# CONFIG_MBEDTLS_CERTIFICATE_BUNDLE_DEFAULT_FULL is not set
CONFIG_MBEDTLS_CERTIFICATE_BUNDLE_DEFAULT_CMN=y
CONFIG_MBEDTLS_CERTIFICATE_BUNDLE_MAX_CERTS=50
CONFIG_MBEDTLS_SSL_IN_CONTENT_LEN=4096
CONFIG_MBEDTLS_SSL_OUT_CONTENT_LEN=2048

# WebRTC memory optimization flags
CONFIG_MBEDTLS_EXTERNAL_MEM_ALLOC=y
CONFIG_SPIRAM_TRY_ALLOCATE_WIFI_LWIP=y
CONFIG_ESP_WIFI_CACHE_TX_BUFFER_NUM=16
CONFIG_ESP_WIFI_STATIC_TX_BUFFER_NUM=8

# Set default target so we don't accidentally build for esp32
CONFIG_IDF_TARGET="esp32s3"

# Robot HAL (Phase 3)
CONFIG_ROBOT_HAL=y
CONFIG_ROBOT_PROBE_TIMEOUT_MS=400
CONFIG_ROBOT_PROBE_CACHE_MS=10000

# Robot HAL (Phase 4)
CONFIG_ROBOT_WIFI_EXEC_TIMEOUT_MS=1500
CONFIG_ROBOT_HTTP_COMMAND_PATH="/command"

# Robot HAL (Phase 5) — IR pins are hardware-dependent: adjust per board.
# Defaults 39/38 = legacy IR module wiring (free on ESP32-S3-BOX-3).
# NEVER use 17 (I2S SCLK) or 18 (I2C SCL): they break audio and I2C.
CONFIG_ROBOT_IR_TX_GPIO=39
CONFIG_ROBOT_IR_RX_GPIO=38
CONFIG_ROBOT_IR_LEARN_TIMEOUT_MS=2500

# Robot HAL (Phase 7) — health monitor + execute watchdog/in-flight cap
CONFIG_ROBOT_HAL_HEALTH_INTERVAL_S=60
CONFIG_ROBOT_HAL_EXEC_WATCHDOG_MS=3000
CONFIG_ROBOT_HAL_MAX_INFLIGHT=2
```
